// SPDX-License-Identifier: GPL-2.0-only

/dts-v1/;

/include/ "msm8953.dtsi"

/ {
	// This is used by the bootloader to find the correct DTB
	qcom,msm-id = <293 0x0>;
	qcom,board-id = <0x1000b 1>;

	model = "Xiaomi Redmi 4 Prime (markw)";
	compatible = "xiaomi,markw", "qcom,msm8953", "lk2nd,device";
	lk2nd,pstore = <0x9ff00000 0x00100000>;

	panel {
		compatible = "xiaomi,markw-panel";

		qcom,mdss_dsi_nt35596_ebbg_1080p_video {
			compatible = "mdss,nt35596-ebbg";
			touchscreen-compatible = "edt,edt-ft5336";
			// touchscreen-compatible = "atmel,maxtouch";
		};
		qcom,mdss_dsi_r63350_1080p_video {
			compatible = "mdss,r63350";
			touchscreen-compatible = "edt,edt-ft5336";
			// touchscreen-compatible = "atmel,maxtouch";
		};
	};
};
