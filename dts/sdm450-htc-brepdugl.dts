 
// SPDX-License-Identifier: GPL-2.0-only

/dts-v1/;

/include/ "msm8952.dtsi"

/ {
	// This is used by the bootloader to find the correct DTB 
	qcom,msm-id = <0x152 0x0>;
	qcom,board-id = <0x2000b 0x0>;

	model = "HTC Desire 12+ (brepdugl)";
	compatible = "htc,brepdugl", "qcom,msm8953", "lk2nd,device";

	// Bootloader won't continue if it can't delete some nodes from below
	soc {
		#address-cells = <1>;
		#size-cells = <1>;
		ranges = <0x0 0x0 0x0 0xffffffff>;

	};
};
