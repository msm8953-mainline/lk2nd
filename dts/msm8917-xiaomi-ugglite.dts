// SPDX-License-Identifier: GPL-2.0-only

/dts-v1/;

/include/ "msm8952.dtsi"

/ {
	// This is used by the bootloader to find the correct DTB 
	qcom,msm-id = <303 0x0>;
	qcom,board-id = <0x08 0>;

	model = "Xiaomi Redmi Note 5A / Y1 Lite (ugglite)";
	compatible = "xiaomi,ugglite", "qcom,msm8917", "lk2nd,device";

	// Bootloader won't continue if it can't delete some nodes from below
	soc {
		#address-cells = <1>;
		#size-cells = <1>;
		ranges = <0x0 0x0 0x0 0xffffffff>;

	};
};
